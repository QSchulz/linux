## Documentation/devicetree/bindings/iio/adc/axp20x_adc.txt
```
X-Powers AXP20X and AXP22X PMIC Analog to Digital Converter (ADC)

The X-Powers AXP20X and AXP22X PMICs have multiple ADCs. They expose the
battery voltage, battery charge and discharge currents, AC-in and VBUS
voltages and currents, 2 GPIOs muxable in ADC mode and PMIC temperature.

The AXP22X PMICs do not have all ADCs of the AXP20X though.

Required properties:
 - compatible, one of:
			"x-powers,axp209-adc"
			"x-powers,axp221-adc"

This is a subnode of the AXP20X PMIC.

Example:

&axp209 {
	axp209_adc: adc {
		compatible = "x-powers,axp209-adc";
	};
};
```

## Documentation/devicetree/bindings/pinctrl/pinctrl-axp209.txt
```
AXP209 GPIO & pinctrl controller

This driver follows the usual GPIO bindings found in
Documentation/devicetree/bindings/gpio/gpio.txt

Required properties:
- compatible: Should be one of:
	- "x-powers,axp209-gpio"
	- "x-powers,axp813-gpio"
- #gpio-cells: Should be two. The first cell is the pin number and the
  second is the GPIO flags.
- gpio-controller: Marks the device node as a GPIO controller.

This node must be a subnode of the axp20x PMIC, documented in
Documentation/devicetree/bindings/mfd/axp20x.txt

Example:

axp209: pmic@34 {
	compatible = "x-powers,axp209";
	reg = <0x34>;
	interrupt-parent = <&nmi_intc>;
	interrupts = <0 IRQ_TYPE_LEVEL_LOW>;
	interrupt-controller;
	#interrupt-cells = <1>;

	axp_gpio: gpio {
		compatible = "x-powers,axp209-gpio";
		gpio-controller;
		#gpio-cells = <2>;
	};
};

The GPIOs can be muxed to other functions and therefore, must be a subnode of
axp_gpio.

Example:

&axp_gpio {
	gpio0_adc: gpio0_adc {
		pins = "GPIO0";
		function = "adc";
	};
};

&example_node {
	pinctrl-names = "default";
	pinctrl-0 = <&gpio0_adc>;
};

GPIOs and their functions
-------------------------

axp209
------
GPIO	|	Functions
------------------------
GPIO0	|	gpio_in, gpio_out, ldo, adc
GPIO1	|	gpio_in, gpio_out, ldo, adc
GPIO2	|	gpio_in, gpio_out

axp813
------
GPIO	|	Functions
------------------------
GPIO0	|	gpio_in, gpio_out, ldo, adc
GPIO1	|	gpio_in, gpio_out, ldo
```

## Documentation/devicetree/bindings/power/supply/axp20x_ac_power.txt
```
AXP20X and AXP22X PMICs' AC power supply

Required Properties:
 - compatible: One of:
			"x-powers,axp202-ac-power-supply"
			"x-powers,axp221-ac-power-supply"

More Required Properties for AXP20X PMICs:
 - io-channels: phandles to ACIN voltage and current ADC channels
 - io-channel-names = "acin_v", "acin_i";

This node is a subnode of the axp20x PMIC.

The AXP20X can read the current current and voltage supplied by AC by
reading ADC channels from the AXP20X ADC.

The AXP22X is only able to tell if an AC power supply is present and
usable.

Example:

&axp209 {
	ac_power_supply: ac_power_supply {
		compatible = "x-powers,axp202-ac-power-supply";
		io-channels = <&axp209_adc 0>, <&axp209_adc 1>;
		io-channel-names = "acin_v", "acin_i";
	};
};
```

## Documentation/devicetree/bindings/power/supply/axp20x_battery.txt
```
AXP20x and AXP22x battery power supply

Required Properties:
 - compatible, one of:
			"x-powers,axp209-battery-power-supply"
			"x-powers,axp221-battery-power-supply"
 - io-channels: phandles to battery voltage, charge and discharge
 currents ADC channels
 - io-channel-names = "batt_v", "batt_chrg_i", "batt_dischrg_i";

This node is a subnode of the axp20x/axp22x PMIC.

The AXP20X and AXP22X can read the battery voltage, charge and discharge
currents of the battery by reading ADC channels from the AXP20X/AXP22X
ADC.

Example:

&axp209 {
	battery_power_supply: battery_power_supply {
		compatible = "x-powers,axp209-battery-power-supply";
		io-channels = <&axp209_adc 7>, <&axp209_adc 8>,
			<&axp209_adc 9>;
		io-channel-names = "batt_v", "batt_chrg_i",
			"batt_dischrg_i";
	}
};
```

## Documentation/devicetree/bindings/power/supply/battery.txt
```
Battery Characteristics

Required Properties:
 - compatible: Must be "fixed-battery"

Optional Properties:
 - voltage-min-design-microvolt: drained battery voltage
 - energy-full-design-microwatt-hours: battery design energy
 - charge-full-design-microamp-hours: battery design capacity
 - constant-charge-microamp: battery constant charge current

Because drivers surface properties in sysfs using names derived
from enum power_supply_property, e.g.
/sys/class/power_supply/<device>/charge_full_design, our
battery properties must be named for the corresponding elements in
enum power_supply_property, defined in include/linux/power_supply.h.

Batteries must be referenced by chargers and/or fuel-gauges
using a phandle. The phandle's property should be named
"monitored-battery".

Driver code should call power_supply_get_battery_info() to obtain
battery properties via monitored-battery. For details see:
  drivers/power/supply/power_supply_core.c
  drivers/power/supply/bq27xxx_battery.c

Example:

	bat: battery {
		compatible = "fixed-battery";
		voltage-min-design-microvolt = <3200000>;
		energy-full-design-microwatt-hours = <5290000>;
		charge-full-design-microamp-hours = <1430000>;
		constant-charge-microamp = <300000>;
	};

	charger: charger@11 {
		....
		monitored-battery = <&bat>;
		...
	};

	fuel_gauge: fuel-gauge@22 {
		....
		monitored-battery = <&bat>;
		...
	};
```

## drivers/net/wireless/espressif/esp8089/Kconfig
```kconfig
#
# Espressif ESP8089 wireless driver
#

config ESP8089
	tristate "Espressif ESP8089 Network Connection"
	depends on CFG80211
	select WIRELESS_EXT
	select WEXT_SPY
	select WEXT_PRIV
	select FW_LOADER
	select LIB80211
	---help---
	 plop
```
